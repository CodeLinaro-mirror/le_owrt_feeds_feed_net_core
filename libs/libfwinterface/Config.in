## libs/libfwinterface/Config.in
```kconfig
config PACKAGE_libfwinterface
    tristate
    select SAH_LIB_FWINTERFACE

if PACKAGE_libfwinterface

menu "Select libfwinterface build options"
    depends on PACKAGE_libfwinterface

config SAH_LIB_FWINTERFACE
    bool "Build the firewall interfaces library"
    default n

choice
    prompt "Choose the interface to use between libfwrules and netfilter"
    default SAH_LIB_FWINTERFACE_INTERFACE_IPTC

config SAH_LIB_FWINTERFACE_INTERFACE_DUMMY
    bool "Dummy interface. Does nothing"

config SAH_LIB_FWINTERFACE_INTERFACE_IPTC
    bool "Use libiptc as the interface"

endchoice

endmenu

endif
```

## modules/mod-dmext/Config.in
```kconfig
config PACKAGE_mod-dmext
    tristate
    select SAH_MOD_DMEXT

if PACKAGE_mod-dmext

menu "Select mod-dmext build options"
    depends on PACKAGE_mod-dmext

config SAH_MOD_DMEXT
    bool "Build data model extension"
    default y

endmenu

endif
```

## plugins/tr181-time/Config.in
```kconfig
config PACKAGE_time-plugin
    tristate
    select SAH_AMX_TR181_TIME

if PACKAGE_time-plugin

menu "Select time-plugin build options"
    depends on PACKAGE_time-plugin

config SAH_AMX_TR181_TIME
    bool "Build a tr181 compatible time plugin"
    default y

config SAH_AMX_TR181_TIME_ORDER
    int "tr181 time plugin start up order"
    default 80

endmenu

endif
```
